## Kconfig
```kconfig
mainmenu "osx86_linux Configuration"
  config OPT_REQUIRED
    bool
    default y
    select DEP_KCONFIG

  menu "Advanced Options"
    menu "Build dependencies"
      config DEP_DMG2IMG
        bool "dmg2img"
      config DEP_PBZX
        bool "pbzx"
      config DEP_KCONFIG
        bool "kconfig"
      config DEP_XAR
        bool "xar"
      config DEP_DARLING_DMG
        bool "darling-dmg"
    endmenu

    menu "Optional OS X Support"
      config OSX_DO_XAR
        select DEP_XAR
        bool "OS X 10.9 Support"
        default y

      config OSX_DO_PBZX
        select DEP_PBZX
        bool "OS X 10.10+ Support"
        default y
    endmenu


    choice
      prompt "Source HFS+ Driver"
      default DRV_DARLING
      ---help---
        Select the HFS+ Driver to use for the source image/filesystem

      config DRV_DARLING
        bool "darling-dmg"
        select DEP_DARLING_DMG
        ---help---
          The darling-dmg driver supports DMG files directly without dmg2img.
          It also supports Korean filenames correctly (avoids warnings on Korean font bundles)

      config DRV_HFSPLUS
        bool "hfsplus"
        select DEP_DMG2IMG
        ---help---
          The hfsplus driver comes from the Linux kernel.
          It doesn't support dmg files directly (requires dmg2img beforehand) and has a bug when handling Korean filenames (https://bugzilla.kernel.org/show_bug.cgi?id=15453)
    endchoice
  endmenu

  choice
    prompt "Target Platform"
    default PLAT_BIOS
    ---help---
      Select the target environment

    config PLAT_BIOS
      bool "Legacy BIOS"
      ---help---
        Select this option to target the Legacy BIOS
        The MBR/PBR will be written to the disk

    config PLAT_UEFI
      bool "UEFI BIOS"
      ---help---
        Select this option to target the UEFI BIOS
        The boot files will be copied to the ESP on the target media
  endchoice

  choice
    prompt "Target Partition Scheme"
    default PART_MBR if PLAT_BIOS
    ---help---
      Select the desired Partitioning Scheme/Layout for the target media

    config PART_MBR
      bool "MBR Scheme"
      ---help---
        The Master Boot Record partition layout. Needed for legacy platforms.
        If you plan to install OS X on a MBR Partition you'll need the MBR patch aswell

    config PART_GPT
      bool "GPT Scheme"
      ---help---
        The GPT partition layout. Recommended when possible as it's the default scheme used in OS X
  endchoice

  choice
    prompt "Target Bootloader"
    default BOOT_CHAMELEON
    ---help---
      Select the desired bootloader to be used on the target media

    config BOOT_CHAMELEON
      bool "Chameleon Boot Loader"
      ---help---
        The Chameleon boot132 based bootloader. Recommended for legacy platforms

    config BOOT_CLOVER
      bool "Clover Boot Loader"
      ---help---
        The Clover Duet based bootloader. Recommended for UEFI platforms

  endchoice
```
